## boards/st/stm32h750vbt6/Kconfig.defconfig
```kconfig
# STM32H750B DISCOVERY board configuration

# Copyright (c) 2024 STMicroelectronics
# SPDX-License-Identifier: Apache-2.0

if BOARD_STM32H750VBT6
 
config BOARD
	default "stm32h750vbt6"

if NETWORKING

config NET_L2_ETHERNET
	default y

endif # NETWORKING

config SPI_STM32_INTERRUPT
	default y
	depends on SPI

config USE_STM32_HAL_GPIO
	default y

config USE_STM32_HAL_MMC
	default y

config USE_STM32_LL_SDMMC
	default y

config USE_STM32_HAL_SD
	default y

config FLASH_LOG_LEVEL
	default 2

endif # BOARD_STM32H750VBT6
```

## boards/st/stm32h750vbt6/Kconfig.stm32h750vbt6
```kconfig
# Copyright (c) 2023 STMicroelectronics
# SPDX-License-Identifier: Apache-2.0

config BOARD_STM32H750VBT6
	select SOC_STM32H750XX
```

## boards/st/stm32h750vbt6/stm32h750vbt6_defconfig
```kconfig
# SPDX-License-Identifier: Apache-2.0
CONFIG_SOC_FLASH_STM32=y
CONFIG_FLASH_STM32_QSPI=y
CONFIG_SYS_CLOCK_HW_CYCLES_PER_SEC=400000000
CONFIG_STM32_MEMMAP=y

# Enable the internal SMPS regulator
CONFIG_POWER_SUPPLY_LDO=y

# Enable HW stack protection
CONFIG_HW_STACK_PROTECTION=y

# enable uart driver
CONFIG_SERIAL=y

# enable console
CONFIG_CONSOLE=y
CONFIG_UART_CONSOLE=y

# enable GPIO
CONFIG_GPIO=y

# Enable clocks
CONFIG_CLOCK_CONTROL=y

# Enable MPU
CONFIG_ARM_MPU=y

# enable clocks
CONFIG_CLOCK_CONTROL=y

# enable pin controller
CONFIG_PINCTRL=y

# 编译出的代码不进行优化，这样便于调试
CONFIG_NO_OPTIMIZATIONS=n
 
```
